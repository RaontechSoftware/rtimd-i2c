## version3/Kconfig
```kconfig
#
# RAONTECH Micro Display I2C driver configuration
#

menu "RAONTECH Micro Display I2C support"

config RTIMD_I2C
	bool "RTIMD-I2C"
	help
	If you want RAONTECH Micro Display I2C support, you should say Y.

choice
	depends on RTIMD_I2C
	prompt "display controller"
	default MDC_RDC200A
	config MDC_RDC200A
		bool "RDC200A"
	config MDC_RDC200
		bool "RDC200"
endchoice

choice
	depends on RTIMD_I2C
	prompt "display panel"
	default PANEL_RDP370F
	config PANEL_RDP370F
		bool "RDP370F"
	config PANEL_RDP502H
		bool "RDP502H"
	config PANEL_RDP551F
		bool "RDP551F"
	config PANEL_RDP700Q
		bool "RDP700Q"		
endchoice	
	
	
if RTIMD_I2C
config RTIMD_I2C_DEBUG
	bool "RTIMD debugging messages"
	help
	  Say Y here if you want the RTIMD_I2C to produce a bunch of debug
	  messages to the system log.  Select this if you are having a
	  problem with RTIMD_I2C support and want to see more of what is going on.

endif # RTIMD_I2C

endmenu
```
